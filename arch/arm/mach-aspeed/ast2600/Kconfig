## drivers/crypto/aspeed/Kconfig
```kconfig
config ASPEED_HACE
	bool "ASPEED Hash and Crypto Engine"
	depends on DM_HASH
	help
	  Select this option to enable a driver for using the SHA engine in
	  the ASPEED BMC SoCs.

	  Enabling this allows the use of SHA operations in hardware without
	  requiring the SHA software implementations. It also improves performance
	  and saves code size.

config ASPEED_ACRY
	bool "ASPEED RSA and ECC Engine"
	depends on ASPEED_AST2600
	help
	 Select this option to enable a driver for using the RSA/ECC engine in
	 the ASPEED BMC SoCs.

	 Enabling this allows the use of RSA/ECC operations in hardware without requiring the
	 software implementations. It also improves performance and saves code size.

config ASPEED_RSSS
	bool "Aspeed RSSS Engine"
	depends on ASPEED_AST2700 || TARGET_ASPEED_AST2700
	help
	  Select here to enable Aspeed RSSS Engine driver.
	  Supports RSA 2048 to 4096 bits encryption/decryption and
	  signature/verification, It's a new hardware design from
          ast2700 for simply SRAM layout.

config ASPEED_CPTRA_SHA
	bool "Caliptra SHA ACC for Aspeed SoCs"
	depends on DM_HASH
	depends on TARGET_ASPEED_AST2700
	help
	  Select this option to enable a driver for using the SHA accelerator provided
	  by Caliptra, which is integrated in AST27xx BMC SoCs.

	  Enabling this allows the use of SHA operations in hardware. Note that only
	  SHA384 and SHA512 are supported by Caliptra.

config ASPEED_CPTRA_ECDSA
	bool "Caliptra ECDSA384 signature verifier for Aspeed SoCs"
	depends on SPL_ECDSA_VERIFY
	depends on TARGET_ASPEED_AST2700
	help
	  Select this option to enable a driver for using the ECDSA384_SIGNATURE_VERIFY
	  feature of Caliptra, which is integrated in AST27xx BMC SoCs.

	  Enabling this allows the use of ECDSA384 signature verification in hardware.
	  Note that only ECDSA384 is supported by Caliptra.

config SPL_ASPEED_MHMAC
	bool "Enable DRAM checksum check feature for Aspeed SoCs"
	depends on TARGET_ASPEED_AST2700
	help
	  Select this option to enable a driver for using the HMAC to check the integrity
	  of DRAM.

config ASPEED_CPTRA_IPC_ECDSA
	bool "Caliptra ECDSA384 signature verifier via IPC for Aspeed SoCs"
	depends on ECDSA_VERIFY
	depends on ASPEED_AST2700
	select ASPEED_CPTRA
	help
	  Select this option to enable a driver for using the ECDSA384_SIGNATURE_VERIFY
	  feature of Caliptra, which is integrated in AST27xx BMC SoCs via IPC.

	  Enabling this allows the use of ECDSA384 signature verification via IPC to BootMCU.
	  Note that only ECDSA384 is supported by Caliptra.

config ASPEED_CPTRA_IPC_SHA
	bool "Caliptra SHA ACC via IPC for Aspeed SoCs"
	depends on DM_HASH
	depends on ASPEED_AST2700
	select ASPEED_CPTRA
	help
	  Select this option to enable a driver for using the SHA accelerator provided
	  by Caliptra, which is integrated in AST27xx BMC SoCs via IPC.

	  Enabling this allows the use of SHA operations in hardware via IPC to BootMCU.
	  Note that only SHA384 and SHA512 are supported by Caliptra.

config ASPEED_CPTRA_MCI_SHA
	bool "Caliptra-SS MCI mailbox SHA-384/512 for Aspeed SoCs"
	depends on DM_HASH
	depends on ASPEED_AST2700 || ASPEED_AST2705
	select ASPEED_CPTRA_MCI_MBOX
	help
	  Select this option to enable a driver for the SHA-384/512 streaming
	  hash commands (MC_SHA_INIT/UPDATE/FINAL) exposed by the Caliptra-SS
	  MCI mailbox, integrated in AST27xx BMC SoCs.

config ASPEED_CPTRA_MCI_ECDSA
	bool "Caliptra-SS MCI mailbox ECDSA384 signature verifier for Aspeed SoCs"
	depends on ECDSA_VERIFY
	depends on ASPEED_AST2700 || ASPEED_AST2705
	select ASPEED_CPTRA_MCI_MBOX
	help
	  Select this option to enable a driver for the MC_ECDSA384_SIG_VERIFY
	  command exposed by the Caliptra-SS MCI mailbox, integrated in AST27xx
	  BMC SoCs. Takes a raw (qx, qy) public key and an already-hashed
	  digest; verification only, no signing.

config ASPEED_CPTRA_MCI_LMS
	bool "Caliptra-SS MCI mailbox LMS signature verifier for Aspeed SoCs"
	depends on ASPEED_AST2700 || ASPEED_AST2705
	select ASPEED_CPTRA_MCI_MBOX
	help
	  Select this option to enable cptra_mci_lms_verify(), wrapping the
	  MC_LMS_SIG_VERIFY command exposed by the Caliptra-SS MCI mailbox.
	  LMS keys are generated offline, so this is verify-only; there is no
	  u-boot LMS uclass, so it is a plain function rather than a DM driver.

config ASPEED_CPTRA_MCI_MLDSA
	bool "Caliptra-SS MCI mailbox ML-DSA-87 signature verifier for Aspeed SoCs"
	depends on ASPEED_AST2700 || ASPEED_AST2705
	select ASPEED_CPTRA_MCI_MBOX
	help
	  Select this option to enable cptra_mci_mldsa87_verify(), wrapping the
	  MC_MLDSA87_SIG_VERIFY command exposed by the Caliptra-SS MCI mailbox.
	  Takes a raw public key; verification only, no signing. There is no
	  u-boot ML-DSA uclass, so it is a plain function rather than a DM
	  driver.
```

## lib/aspeed/Kconfig
```kconfig
config ASPEED_FMC_HEADER
	bool "Enable ASPEED FMC header lib"
	help
	  Support ASPEED proprietary boot FMC header lib

config ASPEED_CPTRA
	bool "Use Caliptra Library"
        help
          This enables the Caliptra common library to communicate with BootMCU
          via IPC in AST27xx SoC series.

config ASPEED_OTP_IPC
	bool "Use BootMCU OTP IPC Library"
	help
	  This enables reading and programming BootMCU OTP over a standalone
	  IPC channel in AST27xx SoC series, independent of the Caliptra IPC
	  library.
```
