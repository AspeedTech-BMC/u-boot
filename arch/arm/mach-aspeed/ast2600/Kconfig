## arch/arm/mach-aspeed/ast2600/Kconfig
```kconfig
if ASPEED_AST2600

config SYS_CPU
	default "armv7"

choice
	prompt "AST2600 board select"
	depends on ASPEED_AST2600
	default TARGET_EVB_AST2600

config TARGET_EVB_AST2600
	bool "EVB-AST2600"
	depends on ASPEED_AST2600
	select ARCH_MISC_INIT
	help
	  EVB-AST2600 is Aspeed evaluation board for AST2600A0 chip.
	  It has 512M of RAM, 32M of SPI flash, two Ethernet ports,
	  4 Serial ports, 4 USB ports, VGA port, PCIe, SD card slot,
	  20 pin JTAG, pinouts for 14 I2Cs, 3 SPIs and eSPI, 8 PWMs.

config TARGET_FPGA_AST2600
	bool "FPGA-AST2600"
	depends on ASPEED_AST2600
	help
	  FPGA-AST2600 is Aspeed FPGA board for AST2600 chip.
	  This is mainly for internal development. Note that
	  most implementation is co-code with EVB-AST2600.

config TARGET_SLT_AST2600
	bool "SLT-AST2600"
	depends on ASPEED_AST2600
	help
	  SLT-AST2600 is Aspeed SLT board for AST2600 chip.

config TARGET_AST2600_IBM
	bool "AST2600-IBM"
	select BOARD_LATE_INIT
	help
	  AST2600-IBM is IBM boards for AST2600 BMC based P0WER10+ servers

config TARGET_AST2600_INTEL
	bool "AST2600-INTEL"
	depends on ASPEED_AST2600
	help
	  AST2600-INTEL is an Intel Eagle Stream CRB with
	  AST2600 as the BMC.

config TARGET_AST2600_DCSCM
	bool "AST2600-DCSCM"
	depends on ASPEED_AST2600
	help
	  AST2600_DCSCM_AVENUE_CITY is an Aspeed demo board in
	  DCSCM form factor.

config TARGET_QUALCOMM_DC_SCM_V1
	bool "QUALCOMM-DC-SCM-V1"
	depends on ASPEED_AST2600
	help
	  QUALCOMM-DC-SCM-V1 is a Qualcomm DC-SCM V1 board which is
	  equipped with AST2600.

endchoice

source "board/aspeed/evb_ast2600/Kconfig"
source "board/aspeed/fpga_ast2600/Kconfig"
source "board/aspeed/slt_ast2600/Kconfig"
source "board/aspeed/ast2600_ibm/Kconfig"
source "board/aspeed/ast2600_intel/Kconfig"
source "board/aspeed/ast2600_dcscm/Kconfig"
source "board/qualcomm/dc-scm-v1/Kconfig"

endif
```

## arch/arm/mach-aspeed/ast2705/Kconfig
```kconfig
if ASPEED_AST2705

config SYS_CPU
	default "armv8"

config SPI_KERNEL_FIT_ADDR
	hex "SPI address of kernel FIT image"
	default 0x100420000
	help
	  Kernel FIT start address in the SPI flash.

choice
	prompt "AST2705 board select"
	depends on ASPEED_AST2705
	default TARGET_EVB_AST2705

config TARGET_EVB_AST2705
	bool "EVB-AST2705"
	depends on ASPEED_AST2705
	select ARCH_MISC_INIT
	help
	  EVB-AST2705 is Aspeed evaluation board for AST2705 chip.
	  It has 512M of RAM, 32M of SPI flash, two Ethernet ports,
	  4 Serial ports, 4 USB ports, VGA port, PCIe, SD card slot,
	  20 pin JTAG, pinouts for 14 I2Cs, 3 SPIs and eSPI, 8 PWMs.

config TARGET_AST2705_DCSCM
	bool "AST2705-DCSCM"
	depends on ASPEED_AST2705
	select ARCH_MISC_INIT
	help
	  AST2705_DCSCM is an Aspeed demo board in DCSCM form factor.

endchoice

source "board/aspeed/evb_ast2705/Kconfig"
source "board/aspeed/ast2705_dcscm/Kconfig"

endif
```

## board/aspeed/ast2705_dcscm/Kconfig
```kconfig
if TARGET_AST2705_DCSCM

config SYS_BOARD
	default "ast2705_dcscm"

config SYS_VENDOR
	default "aspeed"

config SYS_CONFIG_NAME
	string "board configuration name"
	default "ast2705_dcscm"

config AVENUE_CITY_CRB
	bool "Support for Intel Avenue City CRB"
	default n

endif
```

## board/aspeed/evb_ast2600/Kconfig
```kconfig
if TARGET_EVB_AST2600

config SYS_BOARD
	default "evb_ast2600"

config SYS_VENDOR
	default "aspeed"

config SYS_CONFIG_NAME
	string "board configuration name"
	default "evb_ast2600"

config ASPEED_DCSCM_CARD_A2
	bool "AST2600 DCSCM demo board A2 version"
	default n
endif
```

## board/aspeed/evb_ast2705/Kconfig
```kconfig
if TARGET_EVB_AST2705

config SYS_BOARD
	default "evb_ast2705"

config SYS_VENDOR
	default "aspeed"

config SYS_CONFIG_NAME
	string "board configuration name"
	default "evb_ast2705"

endif
```

## cmd/aspeed/Kconfig
```kconfig
config CMD_OTP
	bool "Support OTP utility"
	select AST2600_CMD_OTP if ASPEED_AST2600
	select AST2700_CMD_OTP if ASPEED_AST2700
	default y
	help
	  Enable otp cmd support for Aspeed OTP hardware engine.

config AST2600_CMD_OTP
	bool "Support AST2600 OTP utility"
	depends on CMD_OTP
	depends on SHA256 && SHA384 && SHA512
	help
	  Enable cmd support for Aspeed AST2600 OTP utility.
	  AST2600 OTP utility provides read/program data/conf/strap
	  OTP regions and multiple subcommands supported.

config AST2700_CMD_OTP
	bool "Support AST2700 OTP utility"
	depends on CMD_OTP
	select ASPEED_OTP
	help
	  Enable cmd support for Aspeed AST2700 OTP utility.
	  AST2700 OTP utility provides read/program multiple
	  OTP regions.
	  It also needs Aspeed OTP driver model to support it.

config AST2700_CMD_LTPI_V2
	bool "ASPEED LTPI V2 command"
	depends on ASPEED_AST2700 || ASPEED_AST2705
	select GETOPT
	default n
	help
	  Enable AST2700 LTPI commands for AST2700A1 SoC.

config AST2700_CMD_LTPI_V1
	bool "ASPEED LTPI V1 command"
	depends on ASPEED_AST2700 || ASPEED_AST2705
	select GETOPT
	default n
	help
	  Enable AST2700 LTPI commands for AST2700A0 SoC.

config AST2600_CMD_DPTEST
	bool "ASPEED AST2600 DP CTS utility"
	default n

config AST2700_CMD_DPTEST
	bool "ASPEED AST2700 DP CTS utility"
	default n

config CMD_NETTEST
	bool "ASPEED Ethernet loopback test"
	select GETOPT
	select HEXDUMP
	default n

config CMD_ASPEED_MBOX
	bool "ASPEED Mailbox utility"
	default n
	help
	  Enable ASPEED Mailbox commands for AST2700A1 SoC.

config CMD_CPTRA_MCI
	bool "Caliptra-SS MCI mailbox utility"
	select ASPEED_CPTRA_MCI_MBOX
	select ASPEED_CPTRA_MCI_SHA
	select ASPEED_CPTRA_MCI_ECDSA
	select ASPEED_CPTRA_MCI_LMS
	select ASPEED_CPTRA_MCI_MLDSA
	select ASPEED_CPTRA_MCI_CM
	default n
	help
	  Enable commands for exercising the Caliptra-SS MCI mailbox
	  (aspeed_cptra_mci_mbox driver and its SHA/ECDSA/LMS/ML-DSA-87
	  wrappers), e.g. reading firmware versions and running signature
	  verify tests.
```

## configs/evb-ast2600-ecc_defconfig
```kconfig
CONFIG_ARM=y
CONFIG_SYS_DCACHE_OFF=y
CONFIG_ARCH_ASPEED=y
CONFIG_SYS_TEXT_BASE=0x0
CONFIG_ASPEED_AST2600=y
CONFIG_SYS_MALLOC_F_LEN=0x2000
CONFIG_ENV_SIZE=0x10000
CONFIG_ENV_OFFSET=0xE0000
CONFIG_SPL_SYS_MALLOC_F_LEN=0x800
CONFIG_ARMV7_BOOT_SEC_DEFAULT=y
CONFIG_NR_DRAM_BANKS=1
CONFIG_TPL_SYS_MALLOC_F_LEN=0x800
CONFIG_FIT=y
CONFIG_USE_BOOTARGS=y
CONFIG_BOOTARGS="console=ttyS4,115200n8 root=/dev/ram rw"
CONFIG_USE_BOOTCOMMAND=y
CONFIG_BOOTCOMMAND="bootm 20100000"
CONFIG_SYS_CONSOLE_ENV_OVERWRITE=y
CONFIG_DISPLAY_BOARDINFO_LATE=y
CONFIG_ARCH_EARLY_INIT_R=y
CONFIG_BOARD_EARLY_INIT_F=y
CONFIG_HUSH_PARSER=y
# CONFIG_AUTO_COMPLETE is not set
CONFIG_SYS_PROMPT="ast# "
CONFIG_CMD_MEMTEST=y
CONFIG_SYS_ALT_MEMTEST=y
CONFIG_CMD_CLK=y
CONFIG_CMD_GPIO=y
CONFIG_CMD_I2C=y
CONFIG_CMD_MMC=y
CONFIG_CMD_PART=y
CONFIG_CMD_PCI=y
CONFIG_CMD_SF=y
CONFIG_CMD_USB=y
CONFIG_CMD_DHCP=y
CONFIG_CMD_MII=y
CONFIG_CMD_PING=y
CONFIG_CMD_NCSI=y
CONFIG_CMD_EXT2=y
CONFIG_CMD_EXT4=y
CONFIG_CMD_EXT4_WRITE=y
CONFIG_CMD_FAT=y
CONFIG_CMD_FS_GENERIC=y
CONFIG_CMD_MTDPARTS=y
CONFIG_DEFAULT_DEVICE_TREE="ast2600-evb-ecc"
CONFIG_ENV_IS_IN_SPI_FLASH=y
CONFIG_USE_ENV_SPI_BUS=y
CONFIG_ENV_SPI_BUS=0
CONFIG_USE_ENV_SPI_CS=y
CONFIG_ENV_SPI_CS=0
CONFIG_USE_ENV_SPI_MAX_HZ=y
CONFIG_ENV_SPI_MAX_HZ=100000000
CONFIG_NET_RANDOM_ETHADDR=y
CONFIG_REGMAP=y
CONFIG_SYSCON=y
CONFIG_CLK=y
CONFIG_DM_GPIO=y
CONFIG_ASPEED_GPIO=y
CONFIG_DM_I2C=y
CONFIG_SYS_I2C_ASPEED=y
CONFIG_MISC=y
CONFIG_ASPEED_AHBC=y
CONFIG_ASPEED_H2X=y
CONFIG_ASPEED_DP=y
CONFIG_DM_MMC=y
CONFIG_MMC_SDHCI=y
CONFIG_MMC_SDHCI_ASPEED=y
CONFIG_DM_SPI_FLASH=y
CONFIG_SPI_FLASH=y
CONFIG_SPI_FLASH_GIGADEVICE=y
CONFIG_SPI_FLASH_ISSI=y
CONFIG_SPI_FLASH_MACRONIX=y
CONFIG_SPI_FLASH_SPANSION=y
CONFIG_SPI_FLASH_STMICRO=y
CONFIG_SPI_FLASH_WINBOND=y
CONFIG_PHY_BROADCOM=y
CONFIG_PHY_REALTEK=y
CONFIG_PHY_NCSI=y
CONFIG_DM_ETH=y
CONFIG_PHY_GIGE=y
CONFIG_FTGMAC100=y
CONFIG_MDIO=y
CONFIG_PCI=y
CONFIG_DM_PCI=y
CONFIG_PCIE_ASPEED=y
CONFIG_PHY=y
CONFIG_PINCTRL=y
CONFIG_RAM=y
CONFIG_DM_SERIAL=y
CONFIG_SYS_NS16550=y
CONFIG_SPI=y
CONFIG_DM_SPI=y
CONFIG_SYSRESET=y
CONFIG_USB=y
CONFIG_DM_USB=y
CONFIG_USB_EHCI_HCD=y
CONFIG_USB_STORAGE=y
CONFIG_WDT=y
```

## configs/ibex-ast2700_defconfig
```kconfig
CONFIG_RISCV=y
CONFIG_SYS_DCACHE_OFF=y
# CONFIG_SPL_USE_ARCH_MEMCPY is not set
# CONFIG_SPL_USE_ARCH_MEMMOVE is not set
# CONFIG_SPL_USE_ARCH_MEMSET is not set
CONFIG_TEXT_BASE=0xa0000000
CONFIG_SYS_MALLOC_LEN=0x3000
CONFIG_SYS_MALLOC_F_LEN=0x3000
CONFIG_NR_DRAM_BANKS=1
CONFIG_SPL_LDSCRIPT="arch/$(ARCH)/cpu/ast2700/u-boot-spl.lds"
CONFIG_HAS_CUSTOM_SYS_INIT_SP_ADDR=y
CONFIG_CUSTOM_SYS_INIT_SP_ADDR=0x14ba6800
CONFIG_ENV_SIZE=0x20000
CONFIG_DEFAULT_DEVICE_TREE="ast2700-ibex"
CONFIG_SPL_TEXT_BASE=0x14b80a00
CONFIG_DM_RESET=y
CONFIG_SPL_MMC=y
CONFIG_SPL_SIZE_LIMIT=0x21a00
CONFIG_SPL=y
CONFIG_SYS_MEM_TOP_HIDE=0x10000000
CONFIG_SYS_LOAD_ADDR=0x83000000
CONFIG_BUILD_TARGET=""
CONFIG_TARGET_ASPEED_AST2700=y
CONFIG_FMC_SPECIFIC_OPTIONS=y
CONFIG_SPI_ASPEED_DMA=y
CONFIG_EXTRST_MASK_DEFAULT_INIT=y
CONFIG_ASPEED_EXPORT_LOADER=y
CONFIG_EXPORT_SYMBOL_SIZE=0x100
# CONFIG_RISCV_ISA_F is not set
# CONFIG_RISCV_ISA_A is not set
# CONFIG_SPL_SMP is not set
CONFIG_XIP=y
CONFIG_SPL_XIP=y
# CONFIG_AVAILABLE_HARTS is not set
CONFIG_STACK_SIZE_SHIFT=12
CONFIG_ENV_VARS_UBOOT_CONFIG=y
# CONFIG_SYS_MALLOC_CLEAR_ON_INIT is not set
CONFIG_STACK_SIZE=0x100000
CONFIG_FIT=y
CONFIG_SPL_FIT_SIGNATURE=y
CONFIG_SPL_LOAD_FIT=y
CONFIG_SPL_LOAD_FIT_ADDRESS=0x20100000
CONFIG_SPL_FIT_IMAGE_POST_PROCESS=y
# CONFIG_BOOTSTD is not set
# CONFIG_ARCH_FIXUP_FDT_MEMORY is not set
# CONFIG_CONSOLE_FLUSH_SUPPORT is not set
# CONFIG_CONSOLE_MUX is not set
CONFIG_SYS_STDIO_DEREGISTER=y
CONFIG_BOARD_LATE_INIT=y
CONFIG_SPL_MAX_SIZE=0x21e00
CONFIG_SPL_BSS_START_ADDR=0x14ba6800
CONFIG_SPL_BSS_MAX_SIZE=0x1000
CONFIG_SPL_SHOW_ERRORS=y
# CONFIG_SPL_RAW_IMAGE_SUPPORT is not set
CONFIG_SYS_MMCSD_RAW_MODE_U_BOOT_USE_SECTOR=y
CONFIG_SYS_MMCSD_RAW_MODE_U_BOOT_SECTOR=0x800
CONFIG_SPL_FIT_IMAGE_TINY=y
CONFIG_SPL_MMC_TINY=y
CONFIG_SPL_XIP_SUPPORT=y
CONFIG_SPL_DM_RESET=y
CONFIG_SPL_RAM_SUPPORT=y
CONFIG_SPL_RAM_DEVICE=y
CONFIG_SPL_SATA=y
CONFIG_SPL_SATA_RAW_U_BOOT_USE_SECTOR=y
CONFIG_SPL_SATA_RAW_U_BOOT_SECTOR=0x100
CONFIG_SPL_WATCHDOG=y
CONFIG_SPL_YMODEM_SUPPORT=y
CONFIG_SPL_ASPEED_LOADER_SUPPORT=y
CONFIG_SYS_CBSIZE=256
CONFIG_SYS_PBSIZE=276
# CONFIG_CMD_BOOTD is not set
# CONFIG_CMD_BOOTI is not set
# CONFIG_BOOTM_LINUX is not set
# CONFIG_BOOTM_NETBSD is not set
# CONFIG_BOOTM_PLAN9 is not set
# CONFIG_BOOTM_RTEMS is not set
# CONFIG_BOOTM_VXWORKS is not set
CONFIG_SYS_BOOTM_LEN=0x4000000
# CONFIG_CMD_ELF is not set
# CONFIG_CMD_FDT is not set
# CONFIG_CMD_IMI is not set
# CONFIG_CMD_XIMG is not set
# CONFIG_CMD_SAVEENV is not set
# CONFIG_CMD_CRC32 is not set
# CONFIG_CMD_LOADS is not set
CONFIG_CMD_SYSBOOT=y
# CONFIG_CMD_OTP is not set
CONFIG_DEVICE_TREE_INCLUDES="ast2700-u-boot.dtsi"
# CONFIG_OF_TAG_MIGRATE is not set
CONFIG_SYS_RELOC_GD_ENV_ADDR=y
# CONFIG_NET is not set
CONFIG_SYS_RX_ETH_BUFFER=2
# CONFIG_DM_WARN is not set
# CONFIG_DM_DEVICE_REMOVE is not set
# CONFIG_DM_SEQ_ALIAS is not set
CONFIG_SPL_OF_TRANSLATE=y
# CONFIG_BLOCK_CACHE is not set
CONFIG_SPL_CLK=y
CONFIG_CLK_AST2700=y
# CONFIG_CPU is not set
CONFIG_DM_HASH=y
CONFIG_ASPEED_RSSS=y
CONFIG_ASPEED_CPTRA_SHA=y
CONFIG_ASPEED_CPTRA_ECDSA=y
# CONFIG_GPIO is not set
# CONFIG_I2C is not set
CONFIG_SPL_ASPEED_VBIOS=y
CONFIG_SPL_ASPEED_VGA=y
CONFIG_ASPEED_VGA=y
CONFIG_SPL_ASPEED_DP=y
CONFIG_SPL_ASPEED_EDAF_BRIDGE=y
CONFIG_SLI_TARGET_PHYCLK_1GHZ=y
CONFIG_SLI_K_ON_CPU=y
CONFIG_SPL_PRIVILEGE_CTRL=y
# CONFIG_SPL_ASPEED_UFS is not set
CONFIG_SPL_ASPEED_I3C=y
CONFIG_SPL_ASPEED_USB=y
# CONFIG_SPL_ASPEED_I2C is not set
CONFIG_MMC=y
CONFIG_SUPPORT_EMMC_BOOT=y
CONFIG_MMC_SDHCI=y
CONFIG_MMC_SDHCI_ASPEED=y
# CONFIG_MTD is not set
CONFIG_USE_SYS_MAX_FLASH_BANKS=y
CONFIG_SYS_MAX_FLASH_BANKS=2
# CONFIG_POWER is not set
CONFIG_RAM=y
CONFIG_SPL_RAM=y
CONFIG_ASPEED_RAM=y
CONFIG_ASPEED_MPU=y
# CONFIG_RAM_SIFIVE is not set
CONFIG_RESET_AST2700=y
CONFIG_SCSI=y
CONFIG_DM_SCSI=y
CONFIG_SYS_NS16550=y
CONFIG_SYS_NS16550_MEM32=y
CONFIG_ASPEED_OTP=y
# CONFIG_TIMER is not set
CONFIG_UFS=y
CONFIG_ASPEED_UFS=y
# CONFIG_VIDEO_LOGO is not set
# CONFIG_SPL_WDT is not set
CONFIG_ASPEED_FMC_HEADER=y
CONFIG_SPL_TINY_MEMSET=y
CONFIG_ECDSA=y
CONFIG_SPL_ECDSA_VERIFY=y
CONFIG_SHA384=y
CONFIG_SPL_LZ4=y
# CONFIG_EFI_LOADER is not set
```
