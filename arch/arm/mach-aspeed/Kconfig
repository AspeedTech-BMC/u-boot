## arch/arm/mach-aspeed/Kconfig
```kconfig
if ARCH_ASPEED

config SYS_ARCH
	default "arm"

config SYS_SOC
	default "aspeed"

config SYS_TEXT_BASE
	default 0x00000000

choice
	prompt "Aspeed SoC select"
	depends on ARCH_ASPEED
	default ASPEED_AST2500

config ASPEED_AST2400
        bool "Support Aspeed AST2400 SoC"
        select CPU_ARM926EJS
        help
          The Aspeed AST2400 is a ARM-based SoC with arm926ejs CPU.
          It is used as Board Management Controller on many server boards,
          which is enabled by support of LPC and eSPI peripherals.

config ASPEED_AST2500
	bool "Support Aspeed AST2500 SoC"
	select CPU_ARM1176
	select SUPPORT_SPL
	help
	  The Aspeed AST2500 is a ARM-based SoC with arm1176 CPU.
	  It is used as Board Management Controller on many server boards,
	  which is enabled by support of LPC and eSPI peripherals.

config ASPEED_AST2600
	bool "Support Aspeed AST2600 SoC"
	select CPU_V7A
	select CPU_V7_HAS_NONSEC
	select ARCH_SUPPORT_PSCI
	select SYS_ARCH_TIMER
	select SUPPORT_SPL
	select ENABLE_ARM_SOC_BOOT0_HOOK
	help
	  The Aspeed AST2600 is a ARM-based SoC with Cortex-A7 CPU.
	  It is used as Board Management Controller on many server boards,
	  which is enabled by support of LPC and eSPI peripherals.
endchoice

config ASPEED_PALLADIUM
	bool "Aspeed palladium for simulation"
	default n
	help
	  Say Y here to enable palladium build for simulation.

	  This is mainly for internal verification and investigation
	  on HW design. If not sure, say N.

config ASPEED_ROUTE_UART5_TO_UART1
	bool "Route UART5 console to UART1 pins"
	depends on ASPEED_AST2500
	help
	  Route UART5 console to TXD1/RXD1 pins instead of TXD5/RXD5 pins.
	  Does not affect the debug uart functionality.

config ASPEED_SSP_RERV_MEM
	hex "Reserve memory for SSP"
	default 0x0
	help
	  The size in bytes of reserve memory for ASPEED SoC SSP run.

config ASPEED_DEFAULT_SPI_FREQUENCY
	bool "Using default SPI clock frequency"
	default n
	help
	  Using default SPI clock frequency during
	  early booting up progress.

source "arch/arm/mach-aspeed/ast2400/Kconfig"
source "arch/arm/mach-aspeed/ast2500/Kconfig"
source "arch/arm/mach-aspeed/ast2600/Kconfig"

endif
```

## configs/evb-ast2600-ncsi_defconfig
```kconfig
CONFIG_ARM=y
CONFIG_SYS_CONFIG_NAME="evb_ast2600_spl"
CONFIG_SYS_DCACHE_OFF=y
CONFIG_POSITION_INDEPENDENT=y
CONFIG_SPL_SYS_THUMB_BUILD=y
# CONFIG_SPL_USE_ARCH_MEMCPY is not set
# CONFIG_SPL_USE_ARCH_MEMSET is not set
CONFIG_SPL_LDSCRIPT="arch/$(ARCH)/mach-aspeed/ast2600/u-boot-spl.lds"
CONFIG_ARCH_ASPEED=y
CONFIG_SYS_TEXT_BASE=0x10000
CONFIG_ASPEED_AST2600=y
# CONFIG_ASPEED_LOADERS is not set
CONFIG_SPL_LIBCOMMON_SUPPORT=y
CONFIG_SPL_LIBGENERIC_SUPPORT=y
CONFIG_SYS_MALLOC_F_LEN=0x2000
CONFIG_SPL_MMC_SUPPORT=y
CONFIG_SPL_SERIAL_SUPPORT=y
CONFIG_SPL_DRIVERS_MISC_SUPPORT=y
CONFIG_ENV_SIZE=0x10000
CONFIG_ENV_OFFSET=0xE0000
CONFIG_SPL=y
CONFIG_SPL_STACK_R_ADDR=0x93000000
CONFIG_ARMV7_BOOT_SEC_DEFAULT=y
CONFIG_NR_DRAM_BANKS=1
CONFIG_TPL_SYS_MALLOC_F_LEN=0x800
CONFIG_FIT=y
CONFIG_FIT_ENABLE_SHA384_SUPPORT=y
CONFIG_FIT_ENABLE_SHA512_SUPPORT=y
CONFIG_FIT_SIGNATURE=y
CONFIG_SPL_FIT_SIGNATURE=y
CONFIG_SPL_LOAD_FIT=y
CONFIG_IMAGE_FORMAT_LEGACY=y
CONFIG_USE_BOOTARGS=y
CONFIG_BOOTARGS="console=ttyS4,115200n8 root=/dev/ram rw"
CONFIG_USE_BOOTCOMMAND=y
CONFIG_BOOTCOMMAND="run bootspi"
CONFIG_SYS_CONSOLE_ENV_OVERWRITE=y
CONFIG_DISPLAY_BOARDINFO_LATE=y
CONFIG_ARCH_EARLY_INIT_R=y
CONFIG_BOARD_EARLY_INIT_F=y
CONFIG_SPL_BOARD_INIT=y
# CONFIG_SPL_LEGACY_IMAGE_SUPPORT is not set
CONFIG_SPL_SYS_MALLOC_SIMPLE=y
CONFIG_SPL_STACK_R=y
CONFIG_SPL_SEPARATE_BSS=y
CONFIG_SYS_MMCSD_RAW_MODE_U_BOOT_USE_SECTOR=y
CONFIG_SYS_MMCSD_RAW_MODE_U_BOOT_SECTOR=0x80
CONFIG_SPL_SHA1_SUPPORT=y
CONFIG_SPL_SHA256_SUPPORT=y
CONFIG_SPL_SHA384_SUPPORT=y
CONFIG_SPL_SHA512_SUPPORT=y
CONFIG_SPL_FIT_IMAGE_TINY=y
CONFIG_SPL_DM_RESET=y
CONFIG_SPL_RAM_SUPPORT=y
CONFIG_SPL_RAM_DEVICE=y
CONFIG_SPL_WATCHDOG_SUPPORT=y
CONFIG_SPL_YMODEM_SUPPORT=y
CONFIG_HUSH_PARSER=y
# CONFIG_AUTO_COMPLETE is not set
CONFIG_SYS_PROMPT="ast# "
CONFIG_CMD_MEMTEST=y
CONFIG_SYS_ALT_MEMTEST=y
CONFIG_CMD_CLK=y
CONFIG_CMD_GPIO=y
CONFIG_CMD_I2C=y
CONFIG_CMD_MMC=y
CONFIG_CMD_PART=y
CONFIG_CMD_PCI=y
CONFIG_CMD_SF=y
CONFIG_CMD_USB=y
CONFIG_CMD_DHCP=y
CONFIG_CMD_MII=y
CONFIG_CMD_PING=y
CONFIG_CMD_NCSI=y
CONFIG_CMD_EXT2=y
CONFIG_CMD_EXT4=y
CONFIG_CMD_EXT4_WRITE=y
CONFIG_CMD_FAT=y
CONFIG_CMD_FS_GENERIC=y
CONFIG_CMD_MTDPARTS=y
# CONFIG_DOS_PARTITION is not set
CONFIG_SPL_OF_CONTROL=y
CONFIG_DEFAULT_DEVICE_TREE="ast2600-ncsi"
CONFIG_ENV_IS_IN_SPI_FLASH=y
CONFIG_USE_ENV_SPI_BUS=y
CONFIG_ENV_SPI_BUS=0
CONFIG_USE_ENV_SPI_CS=y
CONFIG_ENV_SPI_CS=0
CONFIG_USE_ENV_SPI_MAX_HZ=y
CONFIG_ENV_SPI_MAX_HZ=100000000
CONFIG_NET_RANDOM_ETHADDR=y
CONFIG_SPL_DM=y
CONFIG_REGMAP=y
CONFIG_SYSCON=y
CONFIG_SPL_OF_TRANSLATE=y
CONFIG_CLK=y
CONFIG_SPL_CLK=y
CONFIG_ASPEED_HACE=y
CONFIG_ASPEED_ACRY=y
CONFIG_DM_GPIO=y
CONFIG_ASPEED_GPIO=y
CONFIG_DM_I2C=y
CONFIG_SYS_I2C_ASPEED=y
CONFIG_MISC=y
CONFIG_ASPEED_AHBC=y
CONFIG_ASPEED_H2X=y
CONFIG_ASPEED_DP=y
CONFIG_DM_MMC=y
CONFIG_SPL_MMC_TINY=y
CONFIG_MMC_SDHCI=y
CONFIG_MMC_SDHCI_ASPEED=y
CONFIG_DM_SPI_FLASH=y
CONFIG_SPI_FLASH=y
CONFIG_SPI_FLASH_SFDP_SUPPORT=y
CONFIG_SPI_FLASH_GIGADEVICE=y
CONFIG_SPI_FLASH_ISSI=y
CONFIG_SPI_FLASH_MACRONIX=y
CONFIG_SPI_FLASH_SPANSION=y
CONFIG_SPI_FLASH_STMICRO=y
CONFIG_SPI_FLASH_WINBOND=y
CONFIG_PHY_BROADCOM=y
CONFIG_PHY_REALTEK=y
CONFIG_PHY_NCSI=y
CONFIG_DM_ETH=y
CONFIG_PHY_GIGE=y
CONFIG_FTGMAC100=y
CONFIG_MDIO=y
CONFIG_PCI=y
CONFIG_DM_PCI=y
CONFIG_PCIE_ASPEED=y
CONFIG_PHY=y
CONFIG_PINCTRL=y
CONFIG_RAM=y
CONFIG_SPL_RAM=y
CONFIG_DM_SERIAL=y
CONFIG_SYS_NS16550=y
CONFIG_SPI=y
CONFIG_DM_SPI=y
CONFIG_SYSRESET=y
CONFIG_TEE=y
CONFIG_USB=y
CONFIG_DM_USB=y
CONFIG_USB_EHCI_HCD=y
CONFIG_USB_STORAGE=y
CONFIG_WDT=y
CONFIG_USE_TINY_PRINTF=y
CONFIG_SPL_TINY_MEMSET=y
```

## drivers/ram/aspeed/Kconfig
```kconfig
if RAM || SPL_RAM

if ASPEED_AST2600
choice
	prompt "DDR4 target data rate"
	default ASPEED_DDR4_1600

config ASPEED_DDR4_400
	bool "DDR4 targets at 400Mbps"
	depends on DM && OF_CONTROL && ARCH_ASPEED
	help
	  select DDR4 target data rate at 400M

config ASPEED_DDR4_800
	bool "DDR4 targets at 800Mbps"
	depends on DM && OF_CONTROL && ARCH_ASPEED
	help
	  select DDR4 target data rate at 800M

config ASPEED_DDR4_1333
	bool "DDR4 targets at 1333Mbps"
	depends on DM && OF_CONTROL && ARCH_ASPEED
	help
	  select DDR4 target data rate at 1333M

config ASPEED_DDR4_1600
	bool "DDR4 targets at 1600Mbps"
	depends on DM && OF_CONTROL && ARCH_ASPEED
	help
	  select DDR4 target data rate at 1600M
endchoice

config ASPEED_DDR4_DUALX8
	bool "dual X8 DDR4 die"
	depends on DM && OF_CONTROL && ARCH_ASPEED
	default n
	help
	  select dual X8 DDR4 die

config ASPEED_BYPASS_SELFTEST
	bool "bypass self test during DRAM initialization"
	default n
	help
	  Say Y here to bypass DRAM self test to speed up the boot time

choice
	prompt "DDR4 PHY side ODT"
	default ASPEED_DDR4_PHY_ODT80

config ASPEED_DDR4_PHY_ODT80
	bool "DDR4 PHY side ODT 80 ohm"
	depends on DM && OF_CONTROL && ARCH_ASPEED
	help
	  select DDR4 PHY side ODT 80 ohm

config ASPEED_DDR4_PHY_ODT60
	bool "DDR4 PHY side ODT 60 ohm"
	depends on DM && OF_CONTROL && ARCH_ASPEED
	help
	  select DDR4 PHY side ODT 60 ohm

config ASPEED_DDR4_PHY_ODT48
	bool "DDR4 PHY side ODT 48 ohm"
	depends on DM && OF_CONTROL && ARCH_ASPEED
	help
	  select DDR4 PHY side ODT 48 ohm

config ASPEED_DDR4_PHY_ODT40
	bool "DDR4 PHY side ODT 40 ohm"
	depends on DM && OF_CONTROL && ARCH_ASPEED
	help
	  select DDR4 PHY side ODT 40 ohm
endchoice

choice
	prompt "DDR4 DRAM side ODT"
	default ASPEED_DDR4_DRAM_ODT48

config ASPEED_DDR4_DRAM_ODT80
	bool "DDR4 DRAM side ODT 80 ohm"
	depends on DM && OF_CONTROL && ARCH_ASPEED
	help
	  select DDR4 DRAM side ODT 80 ohm

config ASPEED_DDR4_DRAM_ODT60
	bool "DDR4 DRAM side ODT 60 ohm"
	depends on DM && OF_CONTROL && ARCH_ASPEED
	help
	  select DDR4 DRAM side ODT 60 ohm

config ASPEED_DDR4_DRAM_ODT48
	bool "DDR4 DRAM side ODT 48 ohm"
	depends on DM && OF_CONTROL && ARCH_ASPEED
	help
	  select DDR4 DRAM side ODT 48 ohm

config ASPEED_DDR4_DRAM_ODT40
	bool "DDR4 DRAM side ODT 40 ohm"
	depends on DM && OF_CONTROL && ARCH_ASPEED
	help
	  select DDR4 DRAM side ODT 40 ohm
endchoice

choice
	prompt "DDR4 DRAM output driver impedance"
	default ASPEED_DDR4_DRAM_RON_34

config ASPEED_DDR4_DRAM_RON_34
	bool "DDR4 DRAM output driver impedance 34 ohm"
	depends on DM && OF_CONTROL && ARCH_ASPEED
	help
	  select DDR4 DRAM output driver impedance 34 ohm

config ASPEED_DDR4_DRAM_RON_48
	bool "DDR4 DRAM output driver impedance 48 ohm"
	depends on DM && OF_CONTROL && ARCH_ASPEED
	help
	  select DDR4 DRAM output driver impedance 48 ohm
endchoice

config ASPEED_DDR4_WR_DATA_EYE_TRAINING_RESULT_OFFSET
	hex "DDR PHY write data eye training result offset"
	default 0x10
	help
	  The offset value applied to the DDR PHY write data eye training result
	  to fine-tune the write DQ/DQS alignment. Please don't change it if you
	  are not sure what is the best value in your system.
endif

endif
```
