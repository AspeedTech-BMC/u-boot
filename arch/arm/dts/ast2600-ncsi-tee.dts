// SPDX-License-Identifier: GPL-2.0+
// Copyright 2023 Aspeed Technology Inc.
/dts-v1/;

#include "ast2600-evb-tee.dts"

/ {
	model = "AST2600 EVB w/ NCSI";
};

&mac2 {
	status = "okay";
	phy-mode = "NC-SI";
	use-ncsi;
	pinctrl-names = "default";
	pinctrl-0 = <&pinctrl_rmii3_default>;
	/delete-property/phy-handle;
};

&mac3 {
	status = "okay";
	phy-mode = "NC-SI";
	use-ncsi;
	pinctrl-names = "default";
	pinctrl-0 = <&pinctrl_rmii4_default>;
	/delete-property/phy-handle;
};
